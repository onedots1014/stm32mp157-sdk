## boards/stm32mp157/onedots_stm32mp157/buildroot/Config.in
```kconfig
comment "Onedots STM32MP157 Board Support"

config BR2_PACKAGE_ONEDOTS_STM32MP157_BOARD_SUPPORT
	bool "Enable Onedots STM32MP157 board support"
	default y
	help
	  Enable support for Onedots STM32MP157 board.
```

## boards/stm32mp157/onedots_stm32mp157/buildroot/configs/onedots_stm32mp157_defconfig
```kconfig
BR2_arm=y
BR2_cortex_a7=y
BR2_PACKAGE_HOST_LINUX_HEADERS_CUSTOM_5_4=y
# Kernel / U-Boot / TF-A / BusyBox come from sources/ (scripts/fetch-sources.sh,
# patches already applied) via the override file below; the git URLs further
# down are only used if the override is removed.
BR2_PACKAGE_OVERRIDE_FILE="$(BR2_EXTERNAL_ONEDOTS_STM32MP157_PATH)/local.mk"
# BR2_ROOTFS_OVERLAY="$(BR2_EXTERNAL_ONEDOTS_STM32MP157_PATH)/board/overlay/"
BR2_ROOTFS_PRE_BUILD_SCRIPT="$(BR2_EXTERNAL_ONEDOTS_STM32MP157_PATH)/board/scripts/post-image.sh"
BR2_ROOTFS_POST_IMAGE_SCRIPT="support/scripts/genimage.sh"
BR2_ROOTFS_POST_SCRIPT_ARGS="-c $(BR2_EXTERNAL_ONEDOTS_STM32MP157_PATH)/board/scripts/genimage-tfa.cfg"
BR2_LINUX_KERNEL=y
BR2_LINUX_KERNEL_CUSTOM_GIT=y
BR2_LINUX_KERNEL_CUSTOM_REPO_URL="https://github.com/STMicroelectronics/linux.git"
BR2_LINUX_KERNEL_CUSTOM_REPO_VERSION="v5.4-stm32mp-r2.4"
BR2_LINUX_KERNEL_DEFCONFIG="onedots_stm32mp157c"
BR2_LINUX_KERNEL_UIMAGE=y
BR2_LINUX_KERNEL_UIMAGE_LOADADDR="0xC2000040"
BR2_LINUX_KERNEL_DTS_SUPPORT=y
BR2_LINUX_KERNEL_INTREE_DTS_NAME="stm32mp157c-onedots-512d-v1"
BR2_LINUX_KERNEL_INSTALL_TARGET=y
BR2_TARGET_ROOTFS_EXT2=y
BR2_TARGET_ROOTFS_EXT2_4=y
BR2_TARGET_ROOTFS_EXT2_SIZE="120M"
# BR2_TARGET_ROOTFS_TAR is not set
BR2_TARGET_ARM_TRUSTED_FIRMWARE=y
BR2_TARGET_ARM_TRUSTED_FIRMWARE_CUSTOM_GIT=y
BR2_TARGET_ARM_TRUSTED_FIRMWARE_CUSTOM_REPO_URL="https://github.com/STMicroelectronics/arm-trusted-firmware.git"
BR2_TARGET_ARM_TRUSTED_FIRMWARE_CUSTOM_REPO_VERSION="v2.10-stm32mp-r3"
BR2_TARGET_ARM_TRUSTED_FIRMWARE_PLATFORM="stm32mp1"
BR2_TARGET_ARM_TRUSTED_FIRMWARE_ADDITIONAL_VARIABLES="DTB_FILE_NAME=onedots-stm32mp157c-evb.dtb AARCH32_SP=sp_min    LOG_LEVEL=40  ARCH=aarch32 ARM_ARCH_MAJOR=7 STM32MP_SDMMC=1 STM32MP_EMMC=1 STM32MP_SPI_NOR=1 STM32MP_RAW_NAND=1 STM32MP_SPI_NAND=1 "
BR2_TARGET_ARM_TRUSTED_FIRMWARE_IMAGES=" *.stm32"
BR2_TARGET_ARM_TRUSTED_FIRMWARE_NEEDS_DTC=y
BR2_TARGET_UBOOT=y
BR2_TARGET_UBOOT_BUILD_SYSTEM_KCONFIG=y
BR2_TARGET_UBOOT_CUSTOM_GIT=y
BR2_TARGET_UBOOT_CUSTOM_REPO_URL="https://github.com/STMicroelectronics/u-boot.git"
BR2_TARGET_UBOOT_CUSTOM_REPO_VERSION="v2020.01-stm32mp-r2.2"
BR2_TARGET_UBOOT_BOARD_DEFCONFIG="stm32mp15_trusted"
BR2_TARGET_UBOOT_NEEDS_PYLIBFDT=y
BR2_TARGET_UBOOT_NEEDS_OPENSSL=y
BR2_TARGET_UBOOT_NEEDS_GNUTLS=y
# BR2_TARGET_UBOOT_FORMAT_BIN is not set
BR2_TARGET_UBOOT_FORMAT_DTB=y
BR2_TARGET_UBOOT_FORMAT_STM32=y
BR2_TARGET_UBOOT_CUSTOM_MAKEOPTS="DEVICE_TREE=stm32mp157c-onedots-512d-v1"
BR2_PACKAGE_HOST_GENIMAGE=y
```
